/* source key position labels */
#include "zmk-helpers/key-labels/36.h"

/* map Zen's extra keys */
#define X_LH  &mo 4      // thumb row, left
#define X_RH  &none // thumb row, right

/* activate bluetooth */
#define CONFIG_WIRELESS

/* source the main keymap */
#include "base.keymap"
