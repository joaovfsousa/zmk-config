#include <behaviors.dtsi>
#include <dt-bindings/zmk/outputs.h>
#include <dt-bindings/zmk/keys.h>
#include <dt-bindings/zmk/ext_power.h>
#ifdef CONFIG_WIRELESS
    #include <dt-bindings/zmk/bt.h>
    #define _BT_SEL_KEYS_ &bt BT_SEL 0 &bt BT_SEL 1 &bt BT_SEL 2 &bt BT_SEL 3 &bt BT_SEL 4
#else
    #define _BT_SEL_KEYS_ &trans &trans &trans &trans &trans
#endif

#ifdef CONFIG_BACKLIGHT
    #include <dt-bindings/zmk/backlight.h>
    #define _BL_KEYS_ &bl BL_TOG
#else
    #define _BL_KEYS_ &none
#endif

#include "zmk-helpers/helper.h"

#define DEF 0
#define NUM 1
#define SYM 2
#define NAV 3
#define SYS 4

#define XXX &none
#define ___ &trans

/* Global settings */

#define QUICK_TAP_MS 150

&sk {  // sticky-key config
    release-after-ms = <900>;  // release after 0.9s
    quick-release;             // no double capitalization when rolling keys
};

&sl {  // sticky-layer config
    ignore-modifiers;          // allow chording sticky mods & layers
};

&lt {  // layer-tap config
    flavor = "balanced";
    tapping-term-ms = <200>;
    quick-tap-ms = <QUICK_TAP_MS>;
};

/* Homerow mods */

#define KEYS_L LT0 LT1 LT2 LT3 LT4 LM0 LM1 LM2 LM3 LM4 LB0 LB1 LB2 LB3 LB4  // left hand
#define KEYS_R RT0 RT1 RT2 RT3 RT4 RM0 RM1 RM2 RM3 RM4 RB0 RB1 RB2 RB3 RB4  // right hand
#ifndef LH2
    #define THUMBS LH1 LH0 RH0 RH1                                          // thumbs on 34 keys
#else
    #define THUMBS LH2 LH1 LH0 RH0 RH1 RH2                                  // thumbs on 36+ keys
#endif

#define MAKE_HRM(NAME, HOLD, TAP, TRIGGER_POS) \
    ZMK_HOLD_TAP(NAME, \
        flavor = "balanced"; \
        tapping-term-ms = <280>; \
        quick-tap-ms = <QUICK_TAP_MS>; \
        require-prior-idle-ms = <150>; \
        bindings = <HOLD>, <TAP>; \
        hold-trigger-key-positions = <TRIGGER_POS>; \
        hold-trigger-on-release; \
    )
MAKE_HRM(hml, &kp, &kp, KEYS_R THUMBS)  // left-hand HRMs
MAKE_HRM(hmr, &kp, &kp, KEYS_L THUMBS)  // right-hand HRMs
MAKE_HRM(hmlg, &kp, &kp, KEYS_L KEYS_R THUMBS)  // left-hand HRM for cmd/ctrl to allow single handed shortcuts

/* Combos, mouse emulation */
#include "combos.dtsi"  // must be sources after HRM-combo hack
#include "mouse.dtsi"
#include "extra_keys.h"

/* Nav cluster */

// long-tap action on hold, short-tap action on all interrupts
#define MT_CORE \
    flavor = "tap-preferred"; \
    tapping-term-ms = <220>; \
    quick-tap-ms = <220>; \
    hold-trigger-key-positions = <0>;

&mt { MT_CORE };

/* Custom behaviors */

// reuse basic mod-morph scheme
#define SIMPLE_MORPH(NAME, MOD, BINDING1, BINDING2) \
    ZMK_MOD_MORPH(NAME, \
        mods = <(MOD_L ## MOD|MOD_R ## MOD)>; \
        bindings = <BINDING1>, <BINDING2>; \
    )
/* New Defs */

// Space layer toggle
// tap: space | shift + tap: Nvim: move after closing char | hold: activate layer
ZMK_HOLD_TAP(lt_spc,
    flavor = "tap-preferred";
    tapping-term-ms = <150>;
    quick-tap-ms = <QUICK_TAP_MS>;
    bindings = <&mo>, <&spc_morph>;
)
SIMPLE_MORPH(spc_morph, SFT, &kp SPACE, &vim_end)
// Move after closing char
ZMK_MACRO(vim_end,
    wait-ms = <0>;
    tap-ms = <5>;
    bindings = <&kp ESC &kp L &kp A>;
)

// Common layer-tap
ZMK_HOLD_TAP(clt,
    flavor = "tap-unless-interrupted";
    tapping-term-ms = <500>;
    quick-tap-ms = <QUICK_TAP_MS>;
    bindings = <&mo>, <&kp>;
)

#define HYPER LA(LC(LS(LGUI)))

/* Keymap */

// ZMK_CONDITIONAL_LAYER(sys, NUM SYM, SYS)  // NUM + SYM --> SYS

ZMK_LAYER(base,
//╭──────╮ ╭─────────────┬─────────────┬─────────────┬─────────────┬─────────────╮ ╭──────╮ ╭─────────────┬─────────────┬─────────────┬─────────────┬─────────────╮ ╭──────╮
    X_LT     &kp Q         &kp W         &kp E         &kp R         &kp T           X_MT     &kp Y         &kp U         &kp I         &kp O         &kp P           X_RT
//├──────┤ ├─────────────┼─────────────┼─────────────┼─────────────┼─────────────┤ ├──────┤ ├─────────────┼─────────────┼─────────────┼─────────────┼─────────────┤ ├──────┤
    X_LM     &hml LCTRL A  &hml LALT S   &hmlg LGUI D  &hml LSHFT F  &hml HYPER G    X_MM     &hmr HYPER H  &hmr RSHFT J  &hmr LGUI K   &hmr LALT L   &hmr LCTRL SEMI X_RM
//├──────┤ ├─────────────┼─────────────┼─────────────┼─────────────┼─────────────┤ ├──────┤ ├─────────────┼─────────────┼─────────────┼─────────────┼─────────────┤ ├──────┤
    X_LB     &kp Z         &kp X         &kp C         &kp V         &kp B           X_MB     &kp N         &kp M         &kp COMMA     &kp DOT       &kp SLASH       X_RB
//├──────┤ ╰─────────────┼─────────────┴─────────────┼─────────────┼─────────────┤ ├──────┤ ├─────────────┼─────────────┼─────────────┴───────────────────────────╯ ├──────┤
    X_LH                                               &lt_spc NUM 0 &clt NAV ESC    X_MH     &kp RETURN    &clt SYM BSPC                                             X_RH
//╰──────╯                                           ╰─────────────┴─────────────╯ ╰──────╯ ╰─────────────┴─────────────╯                                           ╰──────╯
)

ZMK_LAYER(num,
//╭──────╮ ╭─────────────┬─────────────┬─────────────┬─────────────┬─────────────╮ ╭──────╮ ╭─────────────┬─────────────┬─────────────┬─────────────┬─────────────╮ ╭──────╮
    X_LT     &kp N6        &kp N7        &kp N8        &kp N9        &kp N0          X_MT     ___           ___           ___           ___           ___             X_RT
//├──────┤ ├─────────────┼─────────────┼─────────────┼─────────────┼─────────────┤ ├──────┤ ├─────────────┼─────────────┼─────────────┼─────────────┼─────────────┤ ├──────┤
    X_LM     &hml LCTRL N1 &hml LALT N2  &hmlg LGUI N3 &hml LSHFT N4 &hml HYPER N5   X_MM     &hml HYPER N6 &hmr RSHFT N7 &hmr LGUI N8  &hmr LALT N9  &hmr LCTRL N0   X_RM
//├──────┤ ├─────────────┼─────────────┼─────────────┼─────────────┼─────────────┤ ├──────┤ ├─────────────┼─────────────┼─────────────┼─────────────┼─────────────┤ ├──────┤
    X_LB     &kp LA(N1)    &kp LA(N2)    &kp LA(N3)    &kp LA(N4)    &kp LA(N5)      X_MB     &kp LA(N6)    &kp LA(N7)    &kp LA(N8)    &kp LA(N9)    &kp LA(N0)      X_RB
//├──────┤ ╰─────────────┼─────────────┴─────────────┼─────────────┼─────────────┤ ├──────┤ ├─────────────┼─────────────┼─────────────┴───────────────────────────╯ ├──────┤
    X_LH                                               ___           ___             X_MH     ___           ___                                                       X_RH
//╰──────╯                                           ╰─────────────┴─────────────╯ ╰──────╯ ╰─────────────┴─────────────╯                                           ╰──────╯
)

ZMK_LAYER(sym,
//╭──────╮ ╭─────────────────┼────────────────┼─────────────────┼──────────────────┼───────────╮ ╭──────╮ ╭───────────┼───────────────────┼─────────────────┼──────────────────┼─────────────────╮ ╭──────╮
    X_LT     &kp EXCL          &kp AT           &kp HASH          &kp DLLR           &kp PRCNT     X_MT     &kp CARET   &kp AMPS            &kp STAR          &kp LPAR           &kp RPAR            X_RT
//├──────┤ ├─────────────────┼────────────────┼─────────────────┼──────────────────┼───────────┤ ├──────┤ ├───────────┼───────────────────┼─────────────────┼──────────────────┼─────────────────┤ ├──────┤
    X_LM     &hml LCTRL LBKT   &hml LALT RBKT   &hmlg LGUI GRAVE  &hml LSHFT MINUS   &kp HYPER     X_MM     &kp HYPER   &hmr RSHFT PLUS     &hmr LGUI TILDE   &hmr LALT BSLH     &hmr LCTRL APOS     X_RM
//├──────┤ ├─────────────────┼────────────────┼─────────────────┼──────────────────┼───────────┤ ├──────┤ ├───────────┼───────────────────┼─────────────────┼──────────────────┼─────────────────┤ ├──────┤
    X_LB     &kp LBRC          &kp RBRC         &kp TILDE         &kp UNDER          XXX           X_MB     XXX         &kp EQUAL           XXX               &kp PIPE           &kp DQT             X_RB
//├──────┤ ╰─────────────────┼────────────────┴─────────────────┼──────────────────┼───────────┤ ├──────┤ ├───────────┼───────────────────┼─────────────────┴──────────────────┴─────────────────╯ ├──────┤
    X_LH                                                          ___                ___           X_MH     ___           ___                                                                        X_RH
//╰──────╯                                                      ╰──────────────────┴───────────╯ ╰──────╯ ╰───────────┴───────────────────╯                                                        ╰──────╯
)

ZMK_LAYER(nav,
//╭──────╮ ╭─────────────────┼────────────────┼────────────────────┼──────────────────────┼─────────────────╮ ╭──────╮ ╭───────────┼───────────────────┼─────────────────┼──────────────────┼───────────────────────╮ ╭──────╮
    X_LT     XXX               &kp LEFT         &kp UP               &kp DOWN               &kp RIGHT           X_MT     XXX         XXX                 XXX               XXX                &hmr LCTRL LG(LS(N2))     X_RT
//├──────┤ ├─────────────────┼────────────────┼────────────────────┼──────────────────────┼─────────────────┤ ├──────┤ ├───────────┼───────────────────┼─────────────────┼──────────────────┼───────────────────────┤ ├──────┤
    X_LM     &hml LCTRL C_PP   &hml LALT C_PREV &hmlg LGUI C_VOL_UP  &hml LSHFT C_VOL_DN    &hml HYPER C_NEXT   X_MM     &kp LEFT    &kp DOWN            &kp UP            &kp RIGHT          XXX                       X_RM
//├──────┤ ├─────────────────┼────────────────┼────────────────────┼──────────────────────┼─────────────────┤ ├──────┤ ├───────────┼───────────────────┼─────────────────┼──────────────────┼───────────────────────┤ ├──────┤
    X_LB     XXX               XXX              XXX                  XXX                    XXX                 X_MB     XXX         XXX                 XXX               XXX                &kp LG(LS(N5))            X_RB
//├──────┤ ╰─────────────────┼────────────────┴────────────────────┼──────────────────────┼─────────────────┤ ├──────┤ ├───────────┼───────────────────┼─────────────────┴──────────────────┴───────────────────────╯ ├──────┤
    X_LH                                                             ___                    ___                 X_MH     ___           ___                                                                              X_RH
//╰──────╯                                                         ╰──────────────────────┴─────────────────╯ ╰──────╯ ╰───────────┴───────────────────╯                                                              ╰──────╯
)

ZMK_LAYER(sys,
//╭──────╮ ╭─────────────┬─────────────┬─────────────┬─────────────┬─────────────╮          ╭──────╮ ╭─────────────┬───────────────────┬─────────────┬─────────────┬─────────────╮        ╭──────╮
    X_LT                                _BT_SEL_KEYS_                                         X_MT     XXX           &msc SCRL_DOWN      &msc SCRL_UP  XXX           XXX                    X_RT
//├──────┤ ├─────────────┼─────────────┼─────────────┼─────────────┼─────────────┤          ├──────┤ ├─────────────┼───────────────────┼─────────────┼─────────────┼─────────────┤        ├──────┤
    X_LM     &kp LCTRL     &kp LALT      &kp LEFT_GUI  &kp LSHFT     &kp LS(LC(LA(LGUI)))     X_MM     &mmv MOVE_X(-3000)  &mmv MOVE_Y(3000)  &mmv MOVE_Y(-3000)  &mmv MOVE_X(3000) XXX     X_RM
//├──────┤ ├─────────────┼─────────────┼─────────────┼─────────────┼─────────────┤          ├──────┤ ├─────────────┼───────────────────┼─────────────┼─────────────┼─────────────┤        ├──────┤
    X_LB     XXX           XXX           XXX           &bt BT_CLR    &out OUT_TOG             X_MB     &mmv MOVE_LEFT &mmv MOVE_DOWN     &mmv MOVE_UP  &mmv MOVE_RIGHT XXX                  X_RB
//├──────┤ ╰─────────────┼─────────────┴─────────────┼─────────────┼─────────────┤          ├──────┤ ├─────────────┼───────────────────┼─────────────┴───────────────────────────╯        ├──────┤
    X_LH                                               ___           ___                      X_MH     &mkp MB1      &mkp MB2                                                               X_RH
//╰──────╯                                           ╰─────────────┴─────────────╯          ╰──────╯ ╰─────────────┴───────────────────╯                                                  ╰──────╯
)


/* vim: set ft=c tw=174: */
